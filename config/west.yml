## config/west.yml
```yaml
manifest:
  remotes:
    - name: zmk
      url-base: https://github.com/petejohanson/
  projects:
    - name: zmk
      remote: petejohanson
      revision: feat/pointers-move-scroll
      import: app/west.yml
  self:
    path: config
```
